## sensor_client/build/Kconfig/Kconfig.shield
```kconfig
osource "c:/ncs/v2.4.0/nrf/samples/bluetooth/mesh/sensor_server/boards/shields/*/Kconfig.shield"
osource "C:/ncs/v2.4.2/nrf/boards/shields/*/Kconfig.shield"
```

## sensor_client/build/Kconfig/Kconfig.shield.defconfig
```kconfig
osource "c:/ncs/v2.4.0/nrf/samples/bluetooth/mesh/sensor_server/boards/shields/*/Kconfig.defconfig"
osource "C:/ncs/v2.4.2/nrf/boards/shields/*/Kconfig.defconfig"
```

## sensor_server/build/Kconfig/Kconfig.shield
```kconfig
osource "c:/users/omkar/downloads/sensor_server-20230922t070400z-001/sensor_server/boards/shields/*/Kconfig.shield"
osource "c:/ncs/v2.4.0/nrf/samples/bluetooth/mesh/sensor_server/boards/shields/*/Kconfig.shield"
osource "C:/ncs/v2.4.2/nrf/boards/shields/*/Kconfig.shield"
```

## sensor_server/build/Kconfig/Kconfig.shield.defconfig
```kconfig
osource "c:/users/omkar/downloads/sensor_server-20230922t070400z-001/sensor_server/boards/shields/*/Kconfig.defconfig"
osource "c:/ncs/v2.4.0/nrf/samples/bluetooth/mesh/sensor_server/boards/shields/*/Kconfig.defconfig"
osource "C:/ncs/v2.4.2/nrf/boards/shields/*/Kconfig.defconfig"
```
